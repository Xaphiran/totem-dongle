## config/west.yml
```yaml
manifest:
  remotes:
    - name: zmkfirmware
      url-base: https://github.com/zmkfirmware
    - name: carrefinho
      url-base: https://github.com/carrefinho
    - name: zzeneg
      url-base: https://github.com/zzeneg
    - name: srwi
      url-base: https://github.com/srwi
  projects:
    - name: zmk
      remote: zmkfirmware
      revision: main
      import: app/west.yml
    - name: prospector-zmk-module
      remote: carrefinho
      revision: feat/new-status-screens
    - name: zmk-raw-hid
      remote: zzeneg
      revision: main
    - name: zmk-keypeek-layer-notifier
      remote: srwi
      revision: master
  self:
    path: config
```
